/* USER CODE BEGIN Header */
/**
  ******************************************************************************
  * File Name          : freertos.c
  * Description        : Code for freertos applications
  ******************************************************************************
  * @attention
  *
  * Copyright (c) 2024 STMicroelectronics.
  * All rights reserved.
  *
  * This software is licensed under terms that can be found in the LICENSE file
  * in the root directory of this software component.
  * If no LICENSE file comes with this software, it is provided AS-IS.
  *
  ******************************************************************************
  */
/* USER CODE END Header */

/* Includes ------------------------------------------------------------------*/
#include "FreeRTOS.h"
#include "task.h"
#include "main.h"
#include "cmsis_os.h"

/* Private includes ----------------------------------------------------------*/
/* USER CODE BEGIN Includes */
#include "lcd_rgb.h"
#include "lcd_test.h"
#include "touch_800x480.h"
#include "lvgl.h"
#include "lv_port_disp_template.h"
#include "lv_port_indev_template.h"
#include "lv_demo_keypad_encoder.h"
#include "lv_demo_stress.h"
#include "lv_demo_music.h"
#include "lv_demo_widgets.h"
#include "lv_demo_benchmark.h"
#include "SPI_WiFi.h"
#include "usart.h"
#include "spi.h"
#include "stdio.h"
#include "string.h"
#include "SPI_WiFi.h"
#include "cJSON.h"
#include "main.h"
#include "spi.h"
#include "wifi_cfg_page.h"

/* USER CODE END Includes */

/* Private typedef -----------------------------------------------------------*/
/* USER CODE BEGIN PTD */
int fputc(int ch,FILE *f){
	HAL_UART_Transmit(&huart1,(uint8_t *)&ch,1,100);
	return ch;
}
/* USER CODE END PTD */

/* Private define ------------------------------------------------------------*/
/* USER CODE BEGIN PD */

/* USER CODE END PD */

/* Private macro -------------------------------------------------------------*/
/* USER CODE BEGIN PM */

/* USER CODE END PM */

/* Private variables ---------------------------------------------------------*/
/* USER CODE BEGIN Variables */
uint8_t p[1024],p2[1024]={0};
uint8_t p1[1024] ;//__attribute__((at(0x38000000)));
const char jpeg[] = {
	0xFF,0xD8,0xFF,0xE0,0x00,0x10,0x4A,0x46,0x49,0x46,0x00,0x01,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0xFF,
0xFF,0xFF,0xFF,0xFF,0xFF,0xFF,0xFF,0xFF,0xFF,0xFF,0xFF,0xFF,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0x00,
0xF0,0x01,0x40,0x03,0x01,0x22,0x00,0x02,0x11,0x01,0x03,0x11,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0x03,
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0x51,0x54,0x92,0x54,0x74,0xC6,0x2D,0x14,0x51,0x48,0x02,0x8A,0x28,0xA0,0x02,0x92,0x96,0x92,0x80,0x0A,0x28,0xA4,0xA0,0x05,0xA5,0xA0,0x51,0x40,0x1F,0xFF,0xD9

};
/* USER CODE END Variables */
/* Definitions for defaultTask */
osThreadId_t defaultTaskHandle;
const osThreadAttr_t defaultTask_attributes = {
  .name = "defaultTask",
  .stack_size = 2048 * 4,
  .priority = (osPriority_t) osPriorityNormal,
};
/* Definitions for myTask02 */
osThreadId_t myTask02Handle;
const osThreadAttr_t myTask02_attributes = {
  .name = "myTask02",
  .stack_size = 256 * 4,
  .priority = (osPriority_t) osPriorityLow,
};
/* Definitions for myMutex01 */
osMutexId_t myMutex01Handle;
const osMutexAttr_t myMutex01_attributes = {
  .name = "myMutex01"
};

/* Private function prototypes -----------------------------------------------*/
/* USER CODE BEGIN FunctionPrototypes */

/* USER CODE END FunctionPrototypes */

void StartDefaultTask(void *argument);
void StartTask02(void *argument);

void MX_FREERTOS_Init(void); /* (MISRA C 2004 rule 8.1) */

/* Hook prototypes */
void vApplicationTickHook(void);

/* USER CODE BEGIN 3 */
void vApplicationTickHook( void )
{
   /* This function will be called by each tick interrupt if
   configUSE_TICK_HOOK is set to 1 in FreeRTOSConfig.h. User code can be
   added here, but the tick hook is called from an interrupt context, so
   code must not attempt to block, and only the interrupt safe FreeRTOS API
   functions can be used (those that end in FromISR()). */
	lv_tick_inc(1);
}
/* USER CODE END 3 */

/**
  * @brief  FreeRTOS initialization
  * @param  None
  * @retval None
  */
void MX_FREERTOS_Init(void) {
  /* USER CODE BEGIN Init */

  /* USER CODE END Init */
  /* Create the mutex(es) */
  /* creation of myMutex01 */
  myMutex01Handle = osMutexNew(&myMutex01_attributes);

  /* USER CODE BEGIN RTOS_MUTEX */
  /* add mutexes, ... */
  /* USER CODE END RTOS_MUTEX */

  /* USER CODE BEGIN RTOS_SEMAPHORES */
  /* add semaphores, ... */
  /* USER CODE END RTOS_SEMAPHORES */

  /* USER CODE BEGIN RTOS_TIMERS */
  /* start timers, add new ones, ... */
  /* USER CODE END RTOS_TIMERS */

  /* USER CODE BEGIN RTOS_QUEUES */
  /* add queues, ... */
  /* USER CODE END RTOS_QUEUES */

  /* Create the thread(s) */
  /* creation of defaultTask */
  defaultTaskHandle = osThreadNew(StartDefaultTask, NULL, &defaultTask_attributes);

  /* creation of myTask02 */
  myTask02Handle = osThreadNew(StartTask02, NULL, &myTask02_attributes);

  /* USER CODE BEGIN RTOS_THREADS */
  /* add threads, ... */
  /* USER CODE END RTOS_THREADS */

  /* USER CODE BEGIN RTOS_EVENTS */
  /* add events, ... */
  /* USER CODE END RTOS_EVENTS */

}

/* USER CODE BEGIN Header_StartDefaultTask */
/**
  * @brief  Function implementing the defaultTask thread.
  * @param  argument: Not used
  * @retval None
  */
/* USER CODE END Header_StartDefaultTask */
void StartDefaultTask(void *argument)
{
  /* USER CODE BEGIN StartDefaultTask */
  /* Infinite loop */
	ESP_Init_Default_Cfg();
  for(;;)
  {
		osMutexAcquire(myMutex01Handle,portMAX_DELAY);
		lv_task_handler();
		osMutexRelease(myMutex01Handle);
//		int i=0,j=0,k=0,point=0;
//		unsigned char temp_jpeg[1024];
//		int len = sizeof(jpeg);
//		int block = len/1024;
//		
//		for (i=0;i<block;i++)
//		{
//			for(j=0;j<1024;j++)
//			{
//				temp_jpeg[j]=jpeg[point];
//				point = point + 1;
//			}
//			write(&hspi3,temp_jpeg,1024);
//			osDelay(10);
//		}
//		memset(temp_jpeg,0,1024);
//		len=len%1024;
//		for(k=0;k<len;k++)
//		{
//			temp_jpeg[k]=jpeg[point];
//			point = point + 1;
//		}
//		write(&hspi3,temp_jpeg,1024);
    osDelay(10);
  }
  /* USER CODE END StartDefaultTask */
}

/* USER CODE BEGIN Header_StartTask02 */
/**
* @brief Function implementing the myTask02 thread.
* @param argument: Not used
* @retval None
*/
/* USER CODE END Header_StartTask02 */
void StartTask02(void *argument)
{
  /* USER CODE BEGIN StartTask02 */
  /* Infinite loop */
	printf("完成OK\r\n");
  for(;;)
  {
		memset(p1,0,1024);
		if(read(&hspi3,p1,100)==1){
			HAL_UART_Transmit(&huart1,(uint8_t *)p1,1024,100);	
			//printf("%s\r\n",p1);
		}
		//write(&hspi3,"123124",100);
    osDelay(3);
  }
  /* USER CODE END StartTask02 */
}

/* Private application code --------------------------------------------------*/
/* USER CODE BEGIN Application */
void HAL_GPIO_EXTI_Callback(uint16_t GPIO_Pin){
//	if(HAL_GPIO_ReadPin(Data_in_GPIO_Port,Data_in_Pin) == GPIO_PIN_SET){
//		HAL_UART_Transmit(&huart1,(uint8_t *)"Ready",5,100);	
////		while(HAL_GPIO_ReadPin(Hand_Shank_GPIO_Port,Hand_Shank_Pin) == GPIO_PIN_RESET){
////			;
////		}
////		if(HAL_GPIO_ReadPin(Hand_Shank_GPIO_Port,Hand_Shank_Pin) == GPIO_PIN_SET){
////			HAL_SPI_Receive_DMA(&hspi3,p1,1024);
////		}
//	}
}
void HAL_SPI_RxCpltCallback(SPI_HandleTypeDef *hspi){
	if(hspi == &hspi3){
		//printf("SPI接受中断\r\n");
		HAL_UART_Transmit(&huart1,p1,1024,100);	
	}
}
void HAL_SPI_TxCpltCallback(SPI_HandleTypeDef *hspi){
	if(hspi == &hspi3){
		//printf("SPI发送中断\r\n");
	}
}
void HAL_SPI_TxRxCpltCallback(SPI_HandleTypeDef *hspi)
{
	if(hspi==&hspi3)
	{
		//printf("SPI收发中断\r\n");
		SPI_Receive_Flag = 1;
	}
}
/* USER CODE END Application */

